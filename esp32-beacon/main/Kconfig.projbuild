## esp32-beacon/main/Kconfig.projbuild
```kconfig
menu "CatLocator MQTT Service"

config CATLOCATOR_MQTT_URI
    string "MQTT broker URI"
    default "mqtt://catlocator.local:1883"
    help
        URI the beacon will use when connecting to the CatLocator server.

config CATLOCATOR_MQTT_USERNAME
    string "MQTT username"
    default ""

config CATLOCATOR_MQTT_PASSWORD
    string "MQTT password"
    default ""

config CATLOCATOR_MQTT_LWT_TOPIC
    string "MQTT last will topic"
    default "beacons/Will"

config CATLOCATOR_MQTT_LWT_MESSAGE
    string "MQTT last will message"
    default "{\"status\":\"offline\"}"

endmenu

menu "CatLocator LoRa Bridge"

config CATLOCATOR_LORA_SPI_HOST
    int "SPI host"
    range 1 3
    default 2
    help
        SPI host used to communicate with the SX1255 (1=HSPI, 2=VSPI, 3=SPI3).

config CATLOCATOR_LORA_SCLK_GPIO
    int "SCLK GPIO"
    default 36

config CATLOCATOR_LORA_MOSI_GPIO
    int "MOSI GPIO"
    default 35

config CATLOCATOR_LORA_MISO_GPIO
    int "MISO GPIO"
    default 37

config CATLOCATOR_LORA_CS_GPIO
    int "CS GPIO"
    default 34

config CATLOCATOR_LORA_RESET_GPIO
    int "RESET GPIO"
    default 33

endmenu
```

## esp32-beacon/sdkconfig.defaults
```kconfig
CONFIG_IDF_TARGET="esp32s3"
CONFIG_ESPTOOLPY_TARGET="esp32s3"
CONFIG_ESP_SYSTEM_PANIC_PRINT_REBOOT=y
CONFIG_ESP_MAIN_TASK_STACK_SIZE=8192
CONFIG_BT_ENABLED=y
CONFIG_BT_BLE_ENABLED=y
CONFIG_BT_NIMBLE_ENABLED=y
CONFIG_BT_DEVICE_NAME="CatLocatorBeacon"
# Wi-Fi credentials are provisioned at runtime
CONFIG_ESP_EVENT_LOOP_TASK_STACK_SIZE=8192
CONFIG_ESP_SYSTEM_EVENT_TASK_STACK_SIZE=6144
CONFIG_BT_NIMBLE_HOST_TASK_STACK_SIZE=4096
```
